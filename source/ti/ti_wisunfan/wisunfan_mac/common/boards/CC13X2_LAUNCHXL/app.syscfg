/*
 * Address to place reset vector on target device.
 * See the application's linker command file for further section
 * information.
 */
const Hwi = scripting.addModule("/ti/sysbios/family/arm/m3/Hwi");
Hwi.resetVectorAddress = system.utils.bigInt("0", 16);
