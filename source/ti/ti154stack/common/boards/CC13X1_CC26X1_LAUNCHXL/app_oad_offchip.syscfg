/*
 * Address to place reset vector on target device.
 * See the application's linker command file for further section
 * information.
 */
const Hwi = scripting.addModule("/ti/sysbios/family/arm/m3/Hwi");
Hwi.resetVectorAddress = 0xA8;
