/*
 * Copyright (c) 2018-2022, Texas Instruments Incorporated
 * All rights reserved.
 *
 * Redistribution and use in source and binary forms, with or without
 * modification, are permitted provided that the following conditions
 * are met:
 *
 * *  Redistributions of source code must retain the above copyright
 *    notice, this list of conditions and the following disclaimer.
 *
 * *  Redistributions in binary form must reproduce the above copyright
 *    notice, this list of conditions and the following disclaimer in the
 *    documentation and/or other materials provided with the distribution.
 *
 * *  Neither the name of Texas Instruments Incorporated nor the names of
 *    its contributors may be used to endorse or promote products derived
 *    from this software without specific prior written permission.
 *
 * THIS SOFTWARE IS PROVIDED BY THE COPYRIGHT HOLDERS AND CONTRIBUTORS "AS IS"
 * AND ANY EXPRESS OR IMPLIED WARRANTIES, INCLUDING, BUT NOT LIMITED TO,
 * THE IMPLIED WARRANTIES OF MERCHANTABILITY AND FITNESS FOR A PARTICULAR
 * PURPOSE ARE DISCLAIMED. IN NO EVENT SHALL THE COPYRIGHT OWNER OR
 * CONTRIBUTORS BE LIABLE FOR ANY DIRECT, INDIRECT, INCIDENTAL, SPECIAL,
 * EXEMPLARY, OR CONSEQUENTIAL DAMAGES (INCLUDING, BUT NOT LIMITED TO,
 * PROCUREMENT OF SUBSTITUTE GOODS OR SERVICES; LOSS OF USE, DATA, OR PROFITS;
 * OR BUSINESS INTERRUPTION) HOWEVER CAUSED AND ON ANY THEORY OF LIABILITY,
 * WHETHER IN CONTRACT, STRICT LIABILITY, OR TORT (INCLUDING NEGLIGENCE OR
 * OTHERWISE) ARISING IN ANY WAY OUT OF THE USE OF THIS SOFTWARE,
 * EVEN IF ADVISED OF THE POSSIBILITY OF SUCH DAMAGE.
 */
// @cliArgs --board /ti/boards/LP_EM_CC1354P10_6 --rtos freertos

/*
 *  fatsdraw.syscfg
 */

/* ======== Board ======== */
var board = system.deviceData.board.name;

/* ======== SD BoosterPack ======== */
if (!(board.match(/CC32/) || board.match(/LP_CC2652PSIP/))) {
    var SD_BOOST = scripting.addHardware("/ti/boards/boosterpacks/BOOSTXL-SHARP128");
}

/* ======== Kernel Configuration ======== */
system.getScript("kernel_config_release.syscfg.js");

/* ======== Display ======== */
var Display = scripting.addModule("/ti/display/Display");
var displayUART = Display.addInstance();
displayUART.$hardware = system.deviceData.board.components.XDS110UART;

/* ======== GPIO ======== */
var GPIO = scripting.addModule("/ti/drivers/GPIO");
var gpio = GPIO.addInstance();
gpio.$hardware = system.deviceData.board.components.LED0;
gpio.$name = "CONFIG_GPIO_LED_0";

/* ======== SD ======== */
var SD = scripting.addModule("/ti/drivers/SD");
var sd = SD.addInstance();
sd.useFatFS = true;
sd.$name = "CONFIG_SDFatFS_0";

if (board.match(/CC32/)) {
    /* The SDCC32XX driver currently does not support other DMA channels */
    sd.sdHost.dmaTxChannel.$assign = "UDMA_CH24";
    sd.sdHost.dmaRxChannel.$assign = "UDMA_CH23";
}
else if (board.match(/LP_CC2652PSIP/) || board.match(/LP_EM_CC1312PSIP/)) {
    /* LP_CC2652PSIP does not have a DIO connected to BP.8 and needs to be
     * jumpered to BP.28 instead.
     */
    sd.sdSSPin.$assign = "boosterpack.28";
    /* Set the child SPI instance to use the default LP SPI bus */
    sd.spiInstance.$hardware  = system.deviceData.board.components.LP_SPI;
}
else {
    sd.$hardware = SD_BOOST.components.SD_CARD;
}
