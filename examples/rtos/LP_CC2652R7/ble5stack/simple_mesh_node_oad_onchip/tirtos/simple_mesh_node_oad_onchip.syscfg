/*
 * Copyright (c) 2018, Texas Instruments Incorporated
 * All rights reserved.
 *
 * Redistribution and use in source and binary forms, with or without
 * modification, are permitted provided that the following conditions
 * are met:
 *
 * *  Redistributions of source code must retain the above copyright
 *    notice, this list of conditions and the following disclaimer.
 *
 * *  Redistributions in binary form must reproduce the above copyright
 *    notice, this list of conditions and the following disclaimer in the
 *    documentation and/or other materials provided with the distribution.
 *
 * *  Neither the name of Texas Instruments Incorporated nor the names of
 *    its contributors may be used to endorse or promote products derived
 *    from this software without specific prior written permission.
 *
 * THIS SOFTWARE IS PROVIDED BY THE COPYRIGHT HOLDERS AND CONTRIBUTORS "AS IS"
 * AND ANY EXPRESS OR IMPLIED WARRANTIES, INCLUDING, BUT NOT LIMITED TO,
 * THE IMPLIED WARRANTIES OF MERCHANTABILITY AND FITNESS FOR A PARTICULAR
 * PURPOSE ARE DISCLAIMED. IN NO EVENT SHALL THE COPYRIGHT OWNER OR
 * CONTRIBUTORS BE LIABLE FOR ANY DIRECT, INDIRECT, INCIDENTAL, SPECIAL,
 * EXEMPLARY, OR CONSEQUENTIAL DAMAGES (INCLUDING, BUT NOT LIMITED TO,
 * PROCUREMENT OF SUBSTITUTE GOODS OR SERVICES; LOSS OF USE, DATA, OR PROFITS;
 * OR BUSINESS INTERRUPTION) HOWEVER CAUSED AND ON ANY THEORY OF LIABILITY,
 * WHETHER IN CONTRACT, STRICT LIABILITY, OR TORT (INCLUDING NEGLIGENCE OR
 * OTHERWISE) ARISING IN ANY WAY OUT OF THE USE OF THIS SOFTWARE,
 * EVEN IF ADVISED OF THE POSSIBILITY OF SUCH DAMAGE.
 */
// @cliArgs --board /ti/boards/LP_CC2652R7 --rtos tirtos

/*
 *  simple_peripheral_oad_onchip.syscfg
 */

const devFamily = system.getScript("/ti/ble5stack/ble_common.js").device2DeviceFamily(system.deviceData.deviceId);
const lpName = system.getScript("/ti/ble5stack/ble_common.js").getBoardOrLaunchPadName(true);

/**
 * Import the modules used in this configuration.
 */
const ble         = scripting.addModule("/ti/ble5stack/ble");
const CCFG        = scripting.addModule("/ti/devices/CCFG");
const rfDesign    = scripting.addModule("/ti/devices/radioconfig/rfdesign");
const Display     = scripting.addModule("/ti/display/Display");
const displayUART    = Display.addInstance();
const AESCCM      = scripting.addModule("/ti/drivers/AESCCM");
const AESCCM1     = AESCCM.addInstance();
const AESCTRDRBG  = scripting.addModule("/ti/drivers/AESCTRDRBG");
const AESCTRDRBG1 = AESCTRDRBG.addInstance();
const AESCTRDRBG2 = AESCTRDRBG.addInstance();
const AESECB      = scripting.addModule("/ti/drivers/AESECB");
const AESECB1     = AESECB.addInstance();
const ECDH        = scripting.addModule("/ti/drivers/ECDH");
const ECDH1       = ECDH.addInstance();
const GPIO        = scripting.addModule("/ti/drivers/PIN");
const GPIO1       = GPIO.addInstance();
const GPIO2       = GPIO.addInstance();
const GPIO3       = GPIO.addInstance();
const GPIO4       = GPIO.addInstance();
const NVS         = scripting.addModule("/ti/drivers/NVS");
const NVS1        = NVS.addInstance();
const NVS2        = NVS.addInstance();
const Power       = scripting.addModule("/ti/drivers/Power");
const RF          = scripting.addModule("/ti/drivers/RF");
/* ======== RTOS(TIRTOS) ======== */
if (system.getRTOS() === "tirtos") {
    const RTOS = scripting.addModule("/ti/drivers/RTOS");
}
const TRNG        = scripting.addModule("/ti/drivers/TRNG");
const TRNG1       = TRNG.addInstance();

/* ======== Display ======== */
displayUART.$hardware = system.deviceData.board.components.XDS110UART;
displayUART.enableANSI = true;
displayUART.uartBufferSize = 128;
displayUART.useUART2 = false;
displayUART.uart.txPinInstance.outputState = "High";
displayUART.uart.$name = "CONFIG_DISPLAY_UART";
displayUART.uart.txPinInstance.$name = "CONFIG_PIN_UART_TX";
displayUART.uart.rxPinInstance.$name = "CONFIG_PIN_UART_RX";

/* ======== GPIO ======== */

GPIO1.$hardware         = system.deviceData.board.components.BUTTON0;
GPIO1.mode              = "Input";
GPIO1.$name             = "CONFIG_GPIO_BTN1";

GPIO2.$hardware         = system.deviceData.board.components.BUTTON1;
GPIO2.mode              = "Input";
GPIO2.$name             = "CONFIG_GPIO_BTN2";

GPIO3.$hardware         = system.deviceData.board.components.LED_RED;
GPIO3.mode              = "Output";
GPIO3.$name             = "CONFIG_PIN_RLED";

GPIO4.$hardware         = system.deviceData.board.components.LED_GREEN;
GPIO4.mode              = "Output";
GPIO4.$name             = "CONFIG_PIN_GLED";

/* ======== RF ======== */
/* if an antenna component exists, assign it to the rf instance */
if (system.deviceData.board && system.deviceData.board.components.RF) {
    RF.$hardware = system.deviceData.board.components.RF;
}

/* ======== POWER ======== */
if(lpName == "LP_CC2652RB")
{
  Power.calibrateRCOSC_LF = false;
  Power.calibrateRCOSC_HF = false;
}

/* ======== CCFG ======== */
const ccfgSettings = system.getScript("/ti/common/lprf_ccfg_settings.js").ccfgSettings;
for(var setting in ccfgSettings)
{
    CCFG[setting] = ccfgSettings[setting];
}

const bleCcfgSettings = system.getScript("/ti/ble5stack/ble_common.js").centralRoleCcfgSettings;
for(var setting in bleCcfgSettings)
{
    CCFG[setting] = bleCcfgSettings[setting];
}

/* ======== RF Design ======== */
const rfDesignSettings = system.getScript("/ti/common/lprf_rf_design_settings.js").rfDesignSettings;
for(var setting in rfDesignSettings)
{
    rfDesign[setting] = rfDesignSettings[setting];
}

const radioSettings = system.getScript("/ti/ble5stack/ble_common.js").getRadioScript(rfDesign.rfDesign,system.deviceData.deviceId);
const bleRfDesignSettings = radioSettings.rfDesignParams;
for(var setting in bleRfDesignSettings)
{
    rfDesign[setting] = bleRfDesignSettings[setting];
}

/**
 * Write custom configuration values to the imported modules.
 */
ble.rfDesign                                              = rfDesignSettings.rfDesign;
ble.oadFeature                                            = true;
ble.deviceRole                                            = "PERIPHERAL_CFG+CENTRAL_CFG";
ble.lockProject                                           = true;
ble.oadProject                                            = true;
ble.disDevBySerUuid                                       = true;
ble.addressMode                                           = "ADDRMODE_PUBLIC";
ble.scanType                                              = "SCAN_TYPE_PASSIVE";
ble.maxNumIcallEnabledTasks                               = 5;
ble.maxConnNum                                            = 4;
ble.maxPDUSize                                            = 255;
if(lpName == "LP_CC2652RB")
{
    ble.deviceName = "SP OAD on-chip BAW";
}
else
{
    ble.deviceName = "SP OAD on-chip";
}
ble.radioConfig.codeExportConfig.$name                    = "ti_devices_radioconfig_code_export_param0";
ble.connUpdateParamsPeripheral.$name                      = "ti_ble5stack_general_ble_conn_update_params0";
ble.mesh                                                  = true;
ble.meshApp                                              = "meshAndPeriOadOnchip";
ble.gattBearer                                    = false;
ble.uuid                                          = system.utils.bigInt("53696d706c65104da57368204e6f6465",16);
ble.completeCbName                                = "prov_complete_cbk";
ble.resetCbName                                   = "prov_reset_cbk";
ble.Element[0].$name                              = "element_0";
ble.Element[0].model.create(3);
ble.Element[0].model[0].$name                     = "Model_0";
ble.Element[0].model[0].modelType                 = "Vendor";
ble.Element[0].model[0].numOfHandlers             = 4;
ble.Element[0].model[0].handler1.$name            = "ti_ble5stack_mesh_dcd_handlers0";
ble.Element[0].model[0].handler1.handlerOpCode    = 0x00;
ble.Element[0].model[0].handler1.handlerFunction  = "vnd_button_pressed_cb";
ble.Element[0].model[0].handler2.$name            = "ti_ble5stack_mesh_dcd_handlers1";
ble.Element[0].model[0].handler2.handlerOpCode    = 0x01;
ble.Element[0].model[0].handler2.handlerFunction  = "vnd_get_status_cb";
ble.Element[0].model[0].handler3.$name            = "ti_ble5stack_mesh_dcd_handlers2";
ble.Element[0].model[0].handler3.handlerOpCode    = 0x02;
ble.Element[0].model[0].handler3.handlerFunction  = "vnd_notify_status_cb";
ble.Element[0].model[0].handler4.$name           = "ti_ble5stack_mesh_dcd_handlers3";
ble.Element[0].model[0].handler4.handlerOpCode   = 0x03;
ble.Element[0].model[0].handler4.handlerFunction = "get_large_msg_cb";
ble.Element[0].model[1].$name                    = "Model_1";
ble.Element[0].model[1].sigModelName             = "GEN_ONOFF_SRV";
ble.Element[0].model[2].$name                    = "Model_2";
ble.Element[0].model[2].sigModelName             = "GEN_ONOFF_CLI";

AESCCM1.$name = "CONFIG_AESCCM0";

AESCTRDRBG1.$name              = "CONFIG_AESCTRDRBG_0";
AESCTRDRBG1.aesctrObject.$name = "CONFIG_AESCTR_0";

AESCTRDRBG2.$name              = "CONFIG_AESCTRDRBG_1";
AESCTRDRBG2.aesctrObject.$name = "CONFIG_AESCTR_1";

AESECB1.$name = "CONFIG_AESECB0";

ECDH1.$name = "CONFIG_ECDH0";

NVS1.$name                    = "CONFIG_NVSINTERNAL";
NVS1.internalFlash.$name      = "ti_drivers_nvs_NVSCC26XX0";
if(devFamily == "DeviceFamily_CC13X2X7" || devFamily == "DeviceFamily_CC26X2X7")
{
  NVS1.internalFlash.regionBase = 0x82000;
}
else
{
  NVS1.internalFlash.regionBase = 0x34000;
}
NVS1.internalFlash.regionSize = 0x4000;

NVS2.$name                    = "CONFIG_NVSINTERNAL1";
NVS2.internalFlash.$name      = "ti_drivers_nvs_NVSCC26XX1";
if(devFamily == "DeviceFamily_CC13X2X7" || devFamily == "DeviceFamily_CC26X2X7")
{
  NVS2.internalFlash.regionSize = 0x82000;
}
else
{
  NVS2.internalFlash.regionSize = 0x34000;
}
NVS2.internalFlash.regionType = "Pointer";

TRNG1.$name = "CONFIG_TRNG_0";

if (system.getRTOS() === "tirtos7")
{
    /* ******* Add SYS/BIOS 7.x to the configuration ********* */
    /* ================ Kernel (SYS/BIOS) configuration ================ */
    const BIOS  = scripting.addModule("/ti/sysbios/BIOS");
    /*
    * Enable asserts in the BIOS library.
    *
    * Pick one:
    *  - true (default)
    *      Enables asserts for debugging purposes.
    *  - false
    *      Disables asserts for a reduced code footprint and better performance.
    */
    //BIOS.assertsEnabled = true;
    BIOS.assertsEnabled = false;

    /*
    * Runtime instance creation enable flag.
    *
    * Pick one:
    *   - true (default)
    *      Allows Mod_create() and Mod_delete() to be called at runtime which
    *      requires a default heap for dynamic memory allocation.
    *   - false
    *      Reduces code footprint by disallowing Mod_create() and Mod_delete() to
    *      be called at runtime. Object instances are constructed via
    *      Mod_construct() and destructed via Mod_destruct().
    */
    BIOS.runtimeCreatesEnabled = true;
    //BIOS.runtimeCreatesEnabled = false;

    /* ================ Memory configuration ================ */
    /*
    * Use HeapMem primary heap instance to use linker-defined memory region
    * Add HeapTrack on top to find over-writes, invalid frees, and
    * aid in finding the correct sizing of the heap and memory leaks.
    */
    //BIOS.heapBaseAddr = "__primary_heap_start__";
    //BIOS.heapEndAddr = "__primary_heap_end__";
    // BIOS.heapTrackEnabled = true;
    BIOS.heapTrackEnabled = false;
    BIOS.rtsGateType = "BIOS_GateMutexPri";
    BIOS.heapSize = 0x00000000;
    BIOS.heapType = "HeapCallback";

    const HeapMem       = scripting.addModule("/ti/sysbios/heaps/HeapMem", {}, false);

    HeapMem.modGateType = "GateMutexPri";

    const HeapCallback = scripting.addModule("/ti/sysbios/heaps/HeapCallback");

    HeapCallback.initFxn = 'osalHeapInitFxn'; // Call First When BIOS boot. Initialize the Heap Manager.
    HeapCallback.allocInstFxn = 'osalHeapAllocFxn'; // Call for allocating a buffer
    HeapCallback.freeInstFxn = 'osalHeapFreeFxn'; // Call for Freeing a buffer
    HeapCallback.getStatsInstFxn = 'osalHeapGetStatsFxn'; // Return Statistic on the Heap.
    HeapCallback.isBlockingInstFxn = 'osalHeapIsBlockingFxn'; // Return TRUE: This heap is always blocking ('Hwi Gate' like )

    /* ================ POSIX configuration ================ */
    const POSIX = scripting.addModule("/ti/posix/tirtos/Settings");

    /* ================ Clock configuration ================ */
    const Clock         = scripting.addModule("/ti/sysbios/knl/Clock", {}, false);
    /*
    * When using Power and calibrateRCOSC is set to true, this should be set to 10.
    * The timer used by the Clock module supports TickMode_DYNAMIC. This enables us
    * to set the tick period to 10 us without generating the overhead of additional
    * interrupts.
    *
    * Note: The calibrateRCOSC parameter is set within the Power configuration
    *     structure in the "Board.c" file.
    */
    Clock.tickPeriod = 10;
    Clock.swiPriority = 5;

    /* ================ Hwi configuration ================ */
    const Hwi           = scripting.addModule("/ti/sysbios/family/arm/m3/Hwi", {}, false);
    /*
    * Checks for Hwi (system) stack overruns while in the Idle loop.
    *
    * Pick one:
    *  - true (default)
    *      Checks the top word for system stack overflows during the idle loop and
    *      raises an Error if one is detected.
    *  - false
    *      Disabling the runtime check improves runtime performance and yields a
    *      reduced flash footprint.
    */
    //Hwi.checkStackFlag = true;
    Hwi.checkStackFlag = false;

    /*
    * The following options alter the system's behavior when a hardware exception
    * is detected.
    *
    * Pick one:
    *  - Hwi.enableException = true
    *      This option causes the default Hwi.excHandlerFunc function to fully
    *      decode an exception and dump the registers to the system console.
    *      This option raises errors in the Error module and displays the
    *      exception in ROV.
    *  - Hwi.enableException = false
    *      This option reduces code footprint by not decoding or printing the
    *      exception to the system console.
    *      It however still raises errors in the Error module and displays the
    *      exception in ROV.
    *  - Hwi.excHandlerFunc = null
    *      This is the most aggressive option for code footprint savings; but it
    *      can difficult to debug exceptions. It reduces flash footprint by
    *      plugging in a default while(1) trap when exception occur. This option
    *      does not raise an error with the Error module.
    */
    //Hwi.enableException = true;
    Hwi.enableException = false;
    //Hwi.excHandlerFunc = null;

    /*
    * Enable hardware exception generation when dividing by zero.
    *
    * Pick one:
    *  - 0 (default)
    *      Disables hardware exceptions when dividing by zero
    *  - 1
    *      Enables hardware exceptions when dividing by zero
    */
    //Hwi.nvicCCR.DIV_0_TRP = 0;
    //Hwi.nvicCCR.DIV_0_TRP = 1;

    /*
    * Starting address to place the interrupt vector table.
    * Note: This is currently placed in RAM to allow for interrupts to be configured at runtime.
    */
    /* Put interrupt vector at start of RAM so interrupts can be configured at runtime */
    Hwi.resetVectorAddress = system.utils.bigInt("90",16);
    Hwi.vectorTableAddress = system.utils.bigInt("020000000", 16);

    /* ================ Idle configuration ================ */
    const Idle    = scripting.addModule("/ti/sysbios/knl/Idle", {}, false);
    /*
    * The Idle module is used to specify a list of functions to be called when no
    * other tasks are running in the system.
    *
    * Functions added here will be run continuously within the idle task.
    *
    * Function signature:
    *     Void func(Void);
    */
    const powerIdle = Idle.addInstance();
    powerIdle.$name = "powerIdle";
    powerIdle.idleFxn = "Power_idleFunc";


    /* ================ Semaphore configuration ================ */
    var Semaphore = scripting.addModule("/ti/sysbios/knl/Semaphore", {}, false);
    /*
    * Enables global support for Task priority pend queuing.
    *
    * Pick one:
    *  - true (default)
    *      This allows pending tasks to be serviced based on their task priority.
    *  - false
    *      Pending tasks are services based on first in, first out basis.
    */
    //Semaphore.supportsPriority = true;
    Semaphore.supportsPriority = false;

    /*
    * Allows for the implicit posting of events through the semaphore,
    * disable for additional code saving.
    *
    * Pick one:
    *  - true
    *      This allows the Semaphore module to post semaphores and events
    *      simultaneously.
    *  - false (default)
    *      Events must be explicitly posted to unblock tasks.
    *
    //Semaphore.supportsEvents = true;
    Semaphore.supportsEvents = false;


    /* ================ Swi configuration ================ */
    const Swi = scripting.addModule("/ti/sysbios/knl/Swi", {}, false);
    /*
    * A software interrupt is an object that encapsulates a function to be
    * executed and a priority. Software interrupts are prioritized, preempt tasks
    * and are preempted by hardware interrupt service routines.
    *
    * This module is included to allow Swi's in a users' application.
    */
    /*
    * Reduce the number of swi priorities from the default of 16.
    * Decreasing the number of swi priorities yields memory savings.
    */
    Swi.numPriorities = 6;


    /* ================ System configuration ================ */
    const System = scripting.addModule("/ti/sysbios/runtime/System", {}, false);
    /*
    * The Abort handler is called when the system exits abnormally.
    *
    * Pick one:
    *  - System.abortStd (default)
    *      Call the ANSI C Standard 'abort()' to terminate the application.
    *  - System.abortSpin
    *      A lightweight abort function that loops indefinitely in a while(1) trap
    *      function.
    *  - A custom abort handler
    *      A user-defined function. See the System module documentation for
    *      details.
    */
    //System.abortFxn = "System_abortStd";
    System.abortFxn = "System_abortSpin";
    //System.abortFxn = "myAbortSystem";

    /*
    * The Exit handler is called when the system exits normally.
    *
    * Pick one:
    *  - System.exitStd (default)
    *      Call the ANSI C Standard 'exit()' to terminate the application.
    *  - System.exitSpin
    *      A lightweight exit function that loops indefinitely in a while(1) trap
    *      function.
    *  - A custom exit function
    *      A user-defined function. See the System module documentation for
    *      details.
    */
    //System.exitFxn = "System_exitStd";
    System.exitFxn = "System_exitSpin";
    //System.exitFxn = "myExitSystem";

    /*
    * Minimize exit handler array in the System module. The System module includes
    * an array of functions that are registered with System_atexit() which is
    * called by System_exit(). The default value is 8.
    */
    //System.maxAtexitHandlers = 2;

    /*
    * Enable System_printf() to display floats.
    */
    System.extendedFormats = "%f";

    /*
    * The System.SupportModule defines a low-level implementation of System
    * functions such as System_printf(), System_flush(), etc.
    *
    * Pick one pair:
    *  - SysMin
    *      This module maintains an internal configurable circular buffer that
    *      stores the output until System_flush() is called.
    *      The size of the circular buffer is set via SysMin.bufSize.
    *  - SysCallback
    *      SysCallback allows for user-defined implementations for System APIs.
    *      The SysCallback support proxy has a smaller code footprint and can be
    *      used to supply custom System_printf services.
    *      The default SysCallback functions point to stub functions. See the
    *      SysCallback module's documentation.
    */
    //const SysMin = scripting.addModule("/ti/sysbios/runtime/SysMin");
    //SysMin.bufSize = 1024;
    //System.supportModule = "SysMin";
    const SysCallback = scripting.addModule("/ti/sysbios/runtime/SysCallback");
    System.supportModule = "SysCallback";
    //SysCallback.abortFxn = "myUserAbort";
    //SysCallback.exitFxn  = "myUserExit";
    //SysCallback.flushFxn = "myUserFlush";
    //SysCallback.putchFxn = "myUserPutch";
    //SysCallback.readyFxn = "myUserReady";


    /* ================ Error configuration ================ */
    const Error = scripting.addModule("/ti/sysbios/runtime/Error");

    /*
    * The Error policy that is called when there is an error.
    *
    * Pick one:
    *  - Error_SPIN
    *      This is the most light-weight policy that loops indefinitely in a
    *      while(1) trap function.
    *  - Error_UNWIND
    *      This error policy will unwind the call and return to the caller.
    *  - Error_TERMINATE
    *      This error policy will call System_abort() when the error is raised.
    */
    Error.policy = "Error_SPIN";

    /*
    * Pick one:
    *  - true
    *      The details of the error will be printed using System_printf(). This
    *      results in a printf() implementation always being pulled into the
    *      application and adds several kB of flash overhead.
    *  - false
    *      The details of the error will not be printed out.
    */
    Error.printDetails = false;


    /* ================ Task configuration ================ */
    const Task = scripting.addModule("/ti/sysbios/knl/Task", {}, false);
    /*
    * Check task stacks for overflow conditions.
    *
    * Pick one:
    *  - true (default)
    *      Enables runtime checks for task stack overflow conditions during
    *      context switching ("from" and "to")
    *  - false
    *      Disables runtime checks for task stack overflow conditions.
    *
    //Task.checkStackFlag = true;
    Task.checkStackFlag = false;

    /*
    * Set the default task stack size when creating tasks.
    *
    * The default is dependent on the device being used. Reducing the default stack
    * size yields greater memory savings.
    */
    Task.defaultStackSize = 512;

    /*
    * Enables the idle task.
    *
    * Pick one:
    *  - true (default)
    *      Creates a task with priority of 0 which calls idle hook functions. This
    *      option must be set to true to gain power savings provided by the Power
    *      module.
    *  - false
    *      No idle task is created. This option consumes less memory as no
    *      additional default task stack is needed.
    *      To gain power savings by the Power module without having the idle task,
    *      add Idle.run as the Task.allBlockedFunc.
    */
    Task.enableIdleTask = true;
    //Task.enableIdleTask = false;
    //Task.allBlockedFunc = Idle.run;

    /*
    * If Task.enableIdleTask is set to true, this option sets the idle task's
    * stack size.
    *
    * Reducing the idle stack size yields greater memory savings.
    */
    Task.idleTaskStackSize = 768;

    /*
    * Reduce the number of task priorities.
    * The default is 16.
    * Decreasing the number of task priorities yield memory savings.
    */
    Task.numPriorities = 6;


    /* ================ Additional configuration ================ */
    /*
    * Add a few other commonly used modules.
    */
    const Event = scripting.addModule("/ti/sysbios/knl/Event");
    const Mailbox = scripting.addModule("/ti/sysbios/knl/Mailbox");
    const Timestamp = scripting.addModule("/ti/sysbios/runtime/Timestamp");
    /* ================ GateMutexPri configuration ================ */
    var GateMutexPri = scripting.addModule("/ti/sysbios/gates/GateMutexPri");
    const GateMutex    = scripting.addModule("/ti/sysbios/gates/GateMutex");
}
