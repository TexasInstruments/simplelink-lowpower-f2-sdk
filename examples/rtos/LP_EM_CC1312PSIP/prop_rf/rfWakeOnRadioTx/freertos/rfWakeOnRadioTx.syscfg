/*
 * Copyright (c) 2018, Texas Instruments Incorporated
 * All rights reserved.
 *
 * Redistribution and use in source and binary forms, with or without
 * modification, are permitted provided that the following conditions
 * are met:
 *
 * *  Redistributions of source code must retain the above copyright
 *    notice, this list of conditions and the following disclaimer.
 *
 * *  Redistributions in binary form must reproduce the above copyright
 *    notice, this list of conditions and the following disclaimer in the
 *    documentation and/or other materials provided with the distribution.
 *
 * *  Neither the name of Texas Instruments Incorporated nor the names of
 *    its contributors may be used to endorse or promote products derived
 *    from this software without specific prior written permission.
 *
 * THIS SOFTWARE IS PROVIDED BY THE COPYRIGHT HOLDERS AND CONTRIBUTORS "AS IS"
 * AND ANY EXPRESS OR IMPLIED WARRANTIES, INCLUDING, BUT NOT LIMITED TO,
 * THE IMPLIED WARRANTIES OF MERCHANTABILITY AND FITNESS FOR A PARTICULAR
 * PURPOSE ARE DISCLAIMED. IN NO EVENT SHALL THE COPYRIGHT OWNER OR
 * CONTRIBUTORS BE LIABLE FOR ANY DIRECT, INDIRECT, INCIDENTAL, SPECIAL,
 * EXEMPLARY, OR CONSEQUENTIAL DAMAGES (INCLUDING, BUT NOT LIMITED TO,
 * PROCUREMENT OF SUBSTITUTE GOODS OR SERVICES; LOSS OF USE, DATA, OR PROFITS;
 * OR BUSINESS INTERRUPTION) HOWEVER CAUSED AND ON ANY THEORY OF LIABILITY,
 * WHETHER IN CONTRACT, STRICT LIABILITY, OR TORT (INCLUDING NEGLIGENCE OR
 * OTHERWISE) ARISING IN ANY WAY OUT OF THE USE OF THIS SOFTWARE,
 * EVEN IF ADVISED OF THE POSSIBILITY OF SUCH DAMAGE.
 */
// @cliArgs --board /ti/boards/LP_EM_CC1312PSIP --rtos freertos

/*
 *  rfWakeOnRadioTx.syscfg
 */

/* ======== BoosterPack(s) ======== */
// BoosterPacks must be at the top of the .syscfg file
// Check if there is a board before adding display info for the Sharp 96x96 LCD
if (system.deviceData.board && system.deviceData.deviceId != "CC2652P1FSIP" && !(system.deviceData.deviceId.match(/CC26.3/)) && !(system.deviceData.deviceId.match(/CC26.4/)) && !(system.deviceData.deviceId.match(/CC13.4/)))
{
    var BOOSTXL_SHARP128 = scripting.addHardware("/ti/boards/boosterpacks/BOOSTXL-SHARP128");
}

/* ======== RF ======== */
var RF = scripting.addModule("/ti/drivers/RF");

/* if an antenna component exists, assign it to the rf instance */
if (system.deviceData.board && system.deviceData.board.components.RF) {
    RF.$hardware = system.deviceData.board.components.RF;
}

/* ======== LED Red ======== */
var GPIO = scripting.addModule("/ti/drivers/GPIO");  // Add a GPIO module for use by LEDs
var LED_R = GPIO.addInstance();                      // Add an a GPIO module instance for LED_R

/* if a red LED component exists, assign it to the LED_R instance */
if (system.deviceData.board && system.deviceData.board.components.LED_RED) {
    LED_R.$hardware = system.deviceData.board.components.LED_RED;
}
else
{
    LED_R.mode = "Output";  // Set the LED pin to output
}

LED_R.$name = "CONFIG_GPIO_RLED";                     // Descriptive name for the LED_R GPIO

/* ======== LED Green ======== */
var GPIO = scripting.addModule("/ti/drivers/GPIO");  // Add a GPIO module for use by LEDs
var LED_G = GPIO.addInstance();                      // Add an a GPIO module instance for LED_G

/* if a green LED component exists, assign it to the LED_G instance */
if (system.deviceData.board && system.deviceData.board.components.LED_GREEN) {
    LED_G.$hardware = system.deviceData.board.components.LED_GREEN;
}
else
{
    LED_G.mode = "Output";   // Set the LED pin to output
}

LED_G.$name = "CONFIG_GPIO_GLED";                     // Descriptive name for the LED_G GPIO

if (system.deviceData.deviceId === "CC2674R10RGZ"){
    /* ======== GPIO ======== */
    /* Enable GPIO for tracer */
    const GPIO2 = GPIO.addInstance();
    GPIO2.$name             = "GPIO_RFC_TRACE";
    GPIO2.mode              = "Output";
    GPIO2.gpioPin.$assign   = "DIO_4";

    /* Wired mode for FPGA */
    const GPIO3 = GPIO.addInstance();
    GPIO3.$name             = "GPIO_RFC_WIRED_OUT";
    GPIO3.mode              = "Output";
    GPIO3.gpioPin.$assign   = "DIO_29";

    const GPIO4 = GPIO.addInstance();
    GPIO4.$name             = "GPIO_RFC_WIRED_IN";
    GPIO4.gpioPin.$assign   = "DIO_30";
}

/* ======== UART Display ======== */
var Display = scripting.addModule("/ti/display/Display");
var Display_UART = Display.addInstance();

/* if a XDS110UART component exists, assign it to the Display_UART instance */
if (system.deviceData.board && system.deviceData.board.components.XDS110UART) {
    Display_UART.$hardware = system.deviceData.board.components.XDS110UART;
}

Display_UART.$name = "CONFIG_DISPLAY";
Display_UART.uart.$name = "CONFIG_DISPLAY_UART";                    // Descriptive name for Display_UART
Display_UART.uart.txPinInstance.$name = "CONFIG_PIN_UART_TX";  // Descriptive name for UART TX PIN
Display_UART.uart.rxPinInstance.$name = "CONFIG_PIN_UART_RX";  // Descriptive name for UART RX PIN

/* ======== LCD Display ======== */
// Check if there is a board before adding display info for the Sharp 96x96 LCD
if (system.deviceData.board && system.deviceData.deviceId != "CC2652P1FSIP" && !(system.deviceData.deviceId.match(/CC26.3/)) && !(system.deviceData.deviceId.match(/CC26.4/)) && !(system.deviceData.deviceId.match(/CC13.4/)))
{
    /* Add display module and display instance */
    var Display = scripting.addModule("/ti/display/Display");
    var Display_LCD = Display.addInstance();

    /* Set display to use Sharp LCD hardware */
    Display_LCD.$hardware = BOOSTXL_SHARP128.components.SHARP_LCD_DISPLAY;
    Display_LCD.$name = "CONFIG_DISPLAY_SHARP_LCD";

    /* Setup LCD_ENABLE GPIO and PIN */
    Display_LCD.lcdEnable.$name = "CONFIG_GPIO_LCD_ENABLE";

    /* Setup LCD_POWER GPIO and PIN */
    Display_LCD.lcdPower.$name = "CONFIG_GPIO_LCD_POWER";

    /* Setup LCD_CS GPIO and PIN */
    Display_LCD.lcdSS.$name = "CONFIG_GPIO_LCD_SS";

    var SPI_LCD = Display_LCD.spi; // Create reference for Display_LCD SPI setup
    SPI_LCD.sclkPinInstance.$name = "CONFIG_PIN_SPI_CLK";   // Descriptive name for CLK pin
    SPI_LCD.misoPinInstance.$name = "CONFIG_PIN_SPI_MISO";  // Descriptive name for SOMI pin
    SPI_LCD.mosiPinInstance.$name = "CONFIG_PIN_SPI_MOSI";  // Descriptive name for SIMO pin
}

/* ======== Left Button ======== */
var GPIO = scripting.addModule("/ti/drivers/GPIO");  // Add a GPIO module for use by buttons
var BUTTON_L = GPIO.addInstance();                      // Add an a GPIO module instance for BUTTON_L

/* if a BUTTON0 component exists, assign it to the BUTTON_L instance */
if (system.deviceData.board && system.deviceData.board.components.BUTTON0) {
    BUTTON_L.$hardware = system.deviceData.board.components.BUTTON0;
}

BUTTON_L.mode = "Input";                            // Change the GPIO to Input mode
BUTTON_L.$name = "CONFIG_GPIO_BTN1";                // Descriptive name for the BUTTON_L GPIO
BUTTON_L.pull = "Pull Up";                            // Use Pull up resistor
BUTTON_L.interruptTrigger = "Falling Edge";           // GPIO Interrupt Trigger
BUTTON_L.callbackFunction = "NULL";                   // Callback function

/* ======== Radio Configuration ======== */
const commonRf = system.getScript("/ti/prop_rf/prop_rf_common.js");
const boardName = commonRf.getDeviceOrLaunchPadName(true);
const phyFilePath = "/ti/prop_rf/rf_config/" + boardName + "_rf_defaults.js";

// Get the supported proprietary phy for this board as defined by Prop RF
const defaultPhy = system.getScript(phyFilePath).defaultPropPhyList[0];

// Add an instance of the "Custom" RF Stack
const customStack = scripting.addModule("/ti/devices/radioconfig/custom");

// Add the default phy instance
const phyInst = commonRf.addPropPhy(customStack, defaultPhy, true);
phyInst.$name = "RF_Custom_Setting";

// Disable multi-protocol patch
phyInst.codeExportConfig.useMulti = false;

/* ======== RF Design ======== */
var rfDesign = scripting.addModule("ti/devices/radioconfig/rfdesign");
const rfDesignSettings = system.getScript("/ti/common/lprf_rf_design_settings.js").rfDesignSettings;
for(var setting in rfDesignSettings)
{
    rfDesign[setting] = rfDesignSettings[setting];
}

/* ======== Device ======== */
var device = scripting.addModule("ti/devices/CCFG");
const ccfgSettings = system.getScript("/ti/common/lprf_ccfg_settings.js").ccfgSettings;
for(var setting in ccfgSettings)
{
    device[setting] = ccfgSettings[setting];
}
const freertos_release_syscfg_js = system.getScript("freertos/builds/freertos_release.syscfg.js");
