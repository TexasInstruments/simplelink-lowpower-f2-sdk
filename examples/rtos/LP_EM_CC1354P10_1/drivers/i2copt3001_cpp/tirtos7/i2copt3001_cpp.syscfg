/*
 * Copyright (c) 2019-2021, Texas Instruments Incorporated
 * All rights reserved.
 *
 * Redistribution and use in source and binary forms, with or without
 * modification, are permitted provided that the following conditions
 * are met:
 *
 * *  Redistributions of source code must retain the above copyright
 *    notice, this list of conditions and the following disclaimer.
 *
 * *  Redistributions in binary form must reproduce the above copyright
 *    notice, this list of conditions and the following disclaimer in the
 *    documentation and/or other materials provided with the distribution.
 *
 * *  Neither the name of Texas Instruments Incorporated nor the names of
 *    its contributors may be used to endorse or promote products derived
 *    from this software without specific prior written permission.
 *
 * THIS SOFTWARE IS PROVIDED BY THE COPYRIGHT HOLDERS AND CONTRIBUTORS "AS IS"
 * AND ANY EXPRESS OR IMPLIED WARRANTIES, INCLUDING, BUT NOT LIMITED TO,
 * THE IMPLIED WARRANTIES OF MERCHANTABILITY AND FITNESS FOR A PARTICULAR
 * PURPOSE ARE DISCLAIMED. IN NO EVENT SHALL THE COPYRIGHT OWNER OR
 * CONTRIBUTORS BE LIABLE FOR ANY DIRECT, INDIRECT, INCIDENTAL, SPECIAL,
 * EXEMPLARY, OR CONSEQUENTIAL DAMAGES (INCLUDING, BUT NOT LIMITED TO,
 * PROCUREMENT OF SUBSTITUTE GOODS OR SERVICES; LOSS OF USE, DATA, OR PROFITS;
 * OR BUSINESS INTERRUPTION) HOWEVER CAUSED AND ON ANY THEORY OF LIABILITY,
 * WHETHER IN CONTRACT, STRICT LIABILITY, OR TORT (INCLUDING NEGLIGENCE OR
 * OTHERWISE) ARISING IN ANY WAY OUT OF THE USE OF THIS SOFTWARE,
 * EVEN IF ADVISED OF THE POSSIBILITY OF SUCH DAMAGE.
 */
// @cliArgs --board /ti/boards/LP_EM_CC1354P10_1 --rtos tirtos7

/*
 *  i2copt3001_cpp.syscfg
 */

/* ======== Board ======== */
var board = system.deviceData.board.name;

/* ======== Sensors BoosterPack ======== */
var Sensors = scripting.addHardware("/ti/boards/boosterpacks/BP-BASSENSORSMKII");

/* ======== Kernel Configuration ======== */
system.getScript("kernel_config_release.syscfg.js");

/* ======== Display ======== */
var Display = scripting.addModule("/ti/display/Display");
var displayUART = Display.addInstance();
displayUART.$hardware = system.deviceData.board.components.XDS110UART;

/* ======== GPIO ======== */
    var GPIO = scripting.addModule("/ti/drivers/GPIO");
    var GPIO1 = GPIO.addInstance();
    GPIO1.$hardware = system.deviceData.board.components.LED0;
    GPIO1.$name = "CONFIG_GPIO_LED_0";

if (board.match(/CC32/)) {
    var GPIO2 = GPIO.addInstance();
    GPIO2.$name = "CONFIG_GPIO_OPT3001_POWER";
    GPIO2.$hardware = Sensors.components.OPT3001.subComponents.POWER;

    var GPIO3 = GPIO.addInstance();
    GPIO3.$name = "CONFIG_GPIO_OPT3001_INTERRUPT";
    GPIO3.gpioPin.$assign = "boosterpack.7";
    GPIO3.pull = "Pull Up";
    GPIO3.interruptTrigger = "Falling Edge";
}
else if (board.match(/CC13.[12]P/) || board.match(/CC2651P/) || board.match(/CC2653P/)) {
    var GPIO2 = GPIO.addInstance();
    GPIO2.$name = "CONFIG_GPIO_OPT3001_POWER";
    /* We need to assign the power pin on top of the LP_SPI hardware's chip select to match the board header */
    GPIO2.gpioPin.$assign = "boosterpack.18";

    /* That means we also need to suppress the relevant warnings (this pin is connected to hardware) */
    scripting.suppress("@@@.+?@@@", GPIO2, "gpioPin");


    var GPIO3 = GPIO.addInstance();
    GPIO3.$name = "CONFIG_GPIO_OPT3001_INTERRUPT";
    GPIO3.$hardware = Sensors.components.OPT3001.subComponents.ALERT;
    GPIO3.pull = "Pull Up";
    GPIO3.interruptTrigger = "Falling Edge";
}
else if (board.match(/CC2340R5_Q1/)) {
    var GPIO2 = GPIO.addInstance();
    GPIO2.$name = "CONFIG_GPIO_OPT3001_POWER";
    GPIO2.$hardware = Sensors.components.OPT3001.subComponents.POWER;

    var GPIO3 = GPIO.addInstance();
    GPIO3.$name = "CONFIG_GPIO_OPT3001_INTERRUPT";
    GPIO3.gpioPin.$assign = "boosterpack.7";
    GPIO3.pull = "Pull Up";
    GPIO3.interruptTrigger = "Falling Edge";

    /* That means we also need to suppress the relevant warnings (this pin is connected to hardware) */
    scripting.suppress("@@@.+?@@@", GPIO3, "gpioPin");
}
else {
    var GPIO2 = GPIO.addInstance();
    GPIO2.$name = "CONFIG_GPIO_OPT3001_POWER";
    GPIO2.$hardware = Sensors.components.OPT3001.subComponents.POWER;

    var GPIO3 = GPIO.addInstance();
    GPIO3.$name = "CONFIG_GPIO_OPT3001_INTERRUPT";
    GPIO3.$hardware = Sensors.components.OPT3001.subComponents.ALERT;
    GPIO3.pull = "Pull Up";
    GPIO3.interruptTrigger = "Falling Edge";
}

/* ======== I2C ======== */
var I2C = scripting.addModule("/ti/drivers/I2C");
var I2C1 = I2C.addInstance();
I2C1.$name = "CONFIG_I2C_OPT3001";
I2C1.$hardware = Sensors.components.BP_BASSENSORSMKII_I2C;
