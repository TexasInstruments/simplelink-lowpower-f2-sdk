/*
 * Copyright (c) 2018, Texas Instruments Incorporated
 * All rights reserved.
 *
 * Redistribution and use in source and binary forms, with or without
 * modification, are permitted provided that the following conditions
 * are met:
 *
 * *  Redistributions of source code must retain the above copyright
 *    notice, this list of conditions and the following disclaimer.
 *
 * *  Redistributions in binary form must reproduce the above copyright
 *    notice, this list of conditions and the following disclaimer in the
 *    documentation and/or other materials provided with the distribution.
 *
 * *  Neither the name of Texas Instruments Incorporated nor the names of
 *    its contributors may be used to endorse or promote products derived
 *    from this software without specific prior written permission.
 *
 * THIS SOFTWARE IS PROVIDED BY THE COPYRIGHT HOLDERS AND CONTRIBUTORS "AS IS"
 * AND ANY EXPRESS OR IMPLIED WARRANTIES, INCLUDING, BUT NOT LIMITED TO,
 * THE IMPLIED WARRANTIES OF MERCHANTABILITY AND FITNESS FOR A PARTICULAR
 * PURPOSE ARE DISCLAIMED. IN NO EVENT SHALL THE COPYRIGHT OWNER OR
 * CONTRIBUTORS BE LIABLE FOR ANY DIRECT, INDIRECT, INCIDENTAL, SPECIAL,
 * EXEMPLARY, OR CONSEQUENTIAL DAMAGES (INCLUDING, BUT NOT LIMITED TO,
 * PROCUREMENT OF SUBSTITUTE GOODS OR SERVICES; LOSS OF USE, DATA, OR PROFITS;
 * OR BUSINESS INTERRUPTION) HOWEVER CAUSED AND ON ANY THEORY OF LIABILITY,
 * WHETHER IN CONTRACT, STRICT LIABILITY, OR TORT (INCLUDING NEGLIGENCE OR
 * OTHERWISE) ARISING IN ANY WAY OUT OF THE USE OF THIS SOFTWARE,
 * EVEN IF ADVISED OF THE POSSIBILITY OF SUCH DAMAGE.
 */
// @cliArgs --board /ti/boards/LP_EM_CC1354P10_1 --rtos freertos

/*
 *  rfPacketErrorRate.syscfg
 */

/* ======== BoosterPack(s) ======== */
// BoosterPacks must be at the top of the .syscfg file
// Check if there is a board before adding display info for the Sharp 96x96 LCD
if (system.deviceData.board && system.deviceData.deviceId != "CC2652P1FSIP" && !(system.deviceData.deviceId.match(/CC26.3/)) && !(system.deviceData.deviceId.match(/CC26.4/)) && !(system.deviceData.deviceId.match(/CC13.4/)))
{
    var BOOSTXL_SHARP128 = scripting.addHardware("/ti/boards/boosterpacks/BOOSTXL-SHARP128");
}

/* ======== RF ======== */
var RF = scripting.addModule("/ti/drivers/RF");

/* if an antenna component exists, assign it to the rf instance */
if (system.deviceData.board && system.deviceData.board.components.RF) {
    RF.$hardware = system.deviceData.board.components.RF;
}

/* ======== UART Display ======== */
var Display = scripting.addModule("/ti/display/Display");
var Display_UART = Display.addInstance();

/* if a XDS110UART component exists, assign it to the Display_UART instance */
if (system.deviceData.board && system.deviceData.board.components.XDS110UART) {
    Display_UART.$hardware = system.deviceData.board.components.XDS110UART;
}

Display_UART.$name = "CONFIG_DISPLAY";
Display_UART.uart.$name = "CONFIG_DISPLAY_UART";                    // Descriptive name for Display_UART
Display_UART.uart.txPinInstance.$name = "CONFIG_PIN_UART_TX";  // Descriptive name for UART TX PIN
Display_UART.uart.rxPinInstance.$name = "CONFIG_PIN_UART_RX";  // Descriptive name for UART RX PIN

/* ======== LCD Display ======== */
// Check if there is a board before adding display info for the Sharp 96x96 LCD
if (system.deviceData.board && system.deviceData.deviceId != "CC2652P1FSIP" && !(system.deviceData.deviceId.match(/CC26.3/)) && !(system.deviceData.deviceId.match(/CC26.4/)) && !(system.deviceData.deviceId.match(/CC13.4/)))
{
    /* Add display module and display instance */
    var Display = scripting.addModule("/ti/display/Display");
    var Display_LCD = Display.addInstance();

    /* Set display to use Sharp LCD hardware */
    Display_LCD.$hardware = BOOSTXL_SHARP128.components.SHARP_LCD_DISPLAY;
    Display_LCD.$name = "CONFIG_DISPLAY_SHARP_LCD";

    /* Setup LCD_ENABLE GPIO and PIN */
    Display_LCD.lcdEnable.$name = "CONFIG_GPIO_LCD_ENABLE";

    /* Setup LCD_POWER GPIO and PIN */
    Display_LCD.lcdPower.$name = "CONFIG_GPIO_LCD_POWER";

    /* Setup LCD_CS GPIO and PIN */
    Display_LCD.lcdSS.$name = "CONFIG_GPIO_LCD_SS";

    var SPI_LCD = Display_LCD.spi; // Create reference for Display_LCD SPI setup
    SPI_LCD.sclkPinInstance.$name = "CONFIG_PIN_SPI_CLK";   // Descriptive name for CLK pin
    SPI_LCD.misoPinInstance.$name = "CONFIG_PIN_SPI_MISO";  // Descriptive name for SOMI pin
    SPI_LCD.mosiPinInstance.$name = "CONFIG_PIN_SPI_MOSI";  // Descriptive name for SIMO pin
}

/* ======== Left Button ======== */
var GPIO = scripting.addModule("/ti/drivers/GPIO");  // Add a GPIO module for use by buttons
var BUTTON_L = GPIO.addInstance();                      // Add an a GPIO module instance for BUTTON_L

/* if a BUTTON0 component exists, assign it to the BUTTON_L instance */
if (system.deviceData.board && system.deviceData.board.components.BUTTON0) {
    BUTTON_L.$hardware = system.deviceData.board.components.BUTTON0;
}

BUTTON_L.mode = "Input";                              // Change the GPIO to Input mode
BUTTON_L.$name = "CONFIG_GPIO_BTN1";                  // Descriptive name for the BUTTON_L GPIO
BUTTON_L.pull = "Pull Up";                            // Use Pull up resistor
BUTTON_L.interruptTrigger = "Falling Edge";           // GPIO Interrupt Trigger
BUTTON_L.callbackFunction = "NULL";                   // Callback function

/* ======== Right Button ======== */
var GPIO = scripting.addModule("/ti/drivers/GPIO");  // Add a GPIO module for use by buttons
var BUTTON_R = GPIO.addInstance();                   // Add an a GPIO module instance for BUTTON_R

/* if a BUTTON1 component exists, assign it to the BUTTON_R instance */
if (system.deviceData.board && system.deviceData.board.components.BUTTON1) {
    BUTTON_R.$hardware = system.deviceData.board.components.BUTTON1;
}

BUTTON_R.mode = "Input";                            // Change the GPIO to Input mode
BUTTON_R.$name = "CONFIG_GPIO_BTN2";                // Descriptive name for the BUTTON_R GPIO
BUTTON_R.pull = "Pull Up";                            // Use Pull up resistor
BUTTON_R.interruptTrigger = "Falling Edge";           // GPIO Interrupt Trigger
BUTTON_R.callbackFunction = "NULL";                   // Callback function

if (system.deviceData.deviceId === "CC2674R10RGZ"){
    /* ======== GPIO ======== */
    /* Enable GPIO for tracer */
    const GPIO2 = GPIO.addInstance();
    GPIO2.$name             = "GPIO_RFC_TRACE";
    GPIO2.mode              = "Output";
    GPIO2.gpioPin.$assign   = "DIO_4";

    /* Wired mode for FPGA */
    const GPIO3 = GPIO.addInstance();
    GPIO3.$name             = "GPIO_RFC_WIRED_OUT";
    GPIO3.mode              = "Output";
    GPIO3.gpioPin.$assign   = "DIO_29";

    const GPIO4 = GPIO.addInstance();
    GPIO4.$name             = "GPIO_RFC_WIRED_IN";
    GPIO4.gpioPin.$assign   = "DIO_30";
}

/* ======== Radio Configuration ======== */
const commonRf = system.getScript("/ti/prop_rf/prop_rf_common.js");
const boardName = commonRf.getDeviceOrLaunchPadName(true);
const phyFilePath = "/ti/prop_rf/rf_config/" + boardName + "_rf_defaults.js";

// Get the supported BLE phys for this board as defined by Prop RF
const supportedBlePhys = system.getScript(phyFilePath).defaultBlePhyList;

// Get the supported proprietary phys for this board as defined by Prop RF
const supportedPropPhys = system.getScript(phyFilePath).defaultPropPhyList;

// Add an instance of the "Custom" RF Stack
const customStack = scripting.addModule("/ti/devices/radioconfig/custom");
const phyInstances = [];

// Add custom proprietary phy
phyInstances.push(commonRf.addPropPhy(customStack, supportedPropPhys[0], true));
phyInstances[0].$name = "RF_Custom_Setting";

/*
 * Iterate over all the proprietary phys supported by this board adding them to
 * the configuration
 */
for(let phy of supportedPropPhys)
{
    // 200 kbps not supported on P4 board
    if(!((boardName === "CC1352P_4_LAUNCHXL" || boardName === "LP_CC1352P7_4")  && phy.args.$name === "RF_2GFSK200KBPS_Setting"))
    {
        phyInstances.push(commonRf.addPropPhy(customStack, phy, false));
    }
}

/*
 * Iterate over all the BLE phys supported by this board adding them to
 * the configuration
 */
for(let phy of supportedBlePhys)
{
    phyInstances.push(commonRf.addBlePhy(customStack, phy));
}

/*
 * Iterate over all the phys added to the configuration, disabling the 
 * multi-protocol patch for each one
 */
for(let phy of phyInstances)
{
    phy.codeExportConfig.useMulti = true;
}

/* ======== RF Design ======== */
var rfDesign = scripting.addModule("ti/devices/radioconfig/rfdesign");
const rfDesignSettings = system.getScript("/ti/common/lprf_rf_design_settings.js").rfDesignSettings;
for(var setting in rfDesignSettings)
{
    rfDesign[setting] = rfDesignSettings[setting];
}

/* ======== Device ======== */
var device = scripting.addModule("ti/devices/CCFG");
const ccfgSettings = system.getScript("/ti/common/lprf_ccfg_settings.js").ccfgSettings;
for(var setting in ccfgSettings)
{
    device[setting] = ccfgSettings[setting];
}

/*
 * This project supports both Sub-1GHz and 2.4GHz PHYs. By default, the Sub-1GHz
 * PHYs transmit at 14dBm power requiring CCFG_FORCE_VDDR = 1. The 2.4GHz PHYs
 * do not support boost mode. For both to operate at runtime for this project,
 * the TX power of Sub-1GHz phys must be < 14dBm and CCFG_FORCE_VDDR = 0.
 */
if((boardName === "CC1352R1_LAUNCHXL") || (boardName === "CC1352P_2_LAUNCHXL")
    || (boardName === "CC1352P_4_LAUNCHXL"))
{
    for(let phy of phyInstances)
    {
        if((phy.txPower) && (phy.txPower === "14"))
        {
            device.forceVddr = false;
            phy.txPower = "12.5";
        }
        else if((phy.txPower433) && (phy.txPower433 === "14.5"))
        {
            device.forceVddr = false;
            phy.txPower433 = "13";
        }
    }
}

const freertos_release_syscfg_js = system.getScript("freertos/builds/freertos_release.syscfg.js");
